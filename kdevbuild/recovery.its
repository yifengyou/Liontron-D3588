## kdevbuild/recovery.its
```
/*
 * Copyright (C) 2021 Rockchip Electronics Co., Ltd
 *
 * SPDX-License-Identifier: GPL-2.0
 */

/dts-v1/;
/ {
	description = "U-Boot FIT source file for arm";

	images {
		fdt {
			data = /incbin/("/data/rk3588/rk3588-latest/kernel/arch/arm64/boot/dts/rockchip/roc-rk3588-pc-mipi-H245QBN02.dtb");
			type = "flat_dt";
			arch = "arm64";
			compression = "none";
			load = <0xffffff00>;

			hash {
				algo = "sha256";
			};
		};

		kernel {
			data = /incbin/("/data/rk3588/rk3588-latest/kernel/arch/arm64/boot/Image");
			type = "kernel";
			arch = "arm64";
			os = "linux";
			compression = "none";
			entry = <0xffffff01>;
			load = <0xffffff01>;

			hash {
				algo = "sha256";
			};
		};

		ramdisk {
			data = /incbin/("/data/rk3588/rk3588-latest/device/rockchip/rockimg/rk3588-recovery-arm64.cpio.gz");
			type = "ramdisk";
			arch = "arm64";
			os = "linux";
			compression = "none";
			load = <0xffffff02>;

			hash {
				algo = "sha256";
			};
		};

		resource {
			data = /incbin/("/data/rk3588/rk3588-latest/kernel/resource.img");
			type = "multi";
			arch = "arm64";
			compression = "none";

			hash {
				algo = "sha256";
			};
		};
	};

	configurations {
		default = "conf";

		conf {
			rollback-index = <0x00>;
			fdt = "fdt";
			kernel = "kernel";
			ramdisk = "ramdisk";
			multi = "resource";

			signature {
				algo = "sha256,rsa2048";
				padding = "pss";
				key-name-hint = "dev";
				sign-images = "fdt", "kernel", "ramdisk", "multi";
			};
		};
	};
};
```
